## config/west.yml
```yaml
manifest:
  remotes:
    - name: zmkfirmware
      url-base: https://github.com/zmkfirmware
    - name: whoop-t
      url-base: https://github.com/whoop-t
  projects:
    - name: zmk
      remote: zmkfirmware
      revision: main
      import: app/west.yml
    - name: nice-adventure-time
      remote: whoop-t
      revision: main
    - name: nice-futurama-sus
      remote: whoop-t
      revision: main
    - name: nice-fry-button-miss
      remote: whoop-t
      revision: main
  self:
    path: config
```
